## meta-hw/conf/layer.conf
```bitbake
# We have a conf and classes directory, add to BBPATH
BBPATH .= ":${LAYERDIR}"

# We have recipes-* directories, add to BBFILES
BBFILES += "${LAYERDIR}/recipes-*/*/*.bb \
            ${LAYERDIR}/recipes-*/*/*.bbappend"

BBFILE_COLLECTIONS += "meta-hw"
BBFILE_PATTERN_meta-hw = "^${LAYERDIR}/"
BBFILE_PRIORITY_meta-hw = "6"

LAYERDEPENDS_meta-hw = "core"
LAYERSERIES_COMPAT_meta-hw = "dunfell"
```

## meta-sorabhsim/conf/layer.conf
```bitbake
# We have a conf and classes directory, add to BBPATH
BBPATH .= ":${LAYERDIR}"

# We have recipes-* directories, add to BBFILES
BBFILES += "${LAYERDIR}/recipes-*/*/*.bb \
            ${LAYERDIR}/recipes-*/*/*.bbappend"

BBFILE_COLLECTIONS += "meta-sorabhsim"
BBFILE_PATTERN_meta-sorabhsim = "^${LAYERDIR}/"
BBFILE_PRIORITY_meta-sorabhsim = "6"

LAYERDEPENDS_meta-sorabhsim = "core"
LAYERSERIES_COMPAT_meta-sorabhsim = "dunfell"
```
